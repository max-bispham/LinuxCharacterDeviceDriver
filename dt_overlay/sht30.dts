/dts-v1/;
/plugin/;

/ {
	compatible = "brcm,bcm2835";
	
	fragment@0 {
		target = <&i2c1>;
		__overlay__ {
			#address-cells = <1>;
			#size-cells = <0>;
	
			sht30@44 {
				compatible = "adafruit, sht30";
				status = "okay";
				reg = <0x44>;
			};
		};
	};

};
